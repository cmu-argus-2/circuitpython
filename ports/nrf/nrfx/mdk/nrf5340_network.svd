# nrf5340_network register map
Vendor: Nordic Semiconductor; Series: nrf53; File version: 1
CPU: CM33 r0p4, little endian, MPU, no FPU, 3 interrupt priority bits, 30 interrupts
Registers are 32-bit, read-write, reset 0x0 unless marked. A register's access mark holds for its fields unless they carry their own. Offsets are from the block's base; [hi:lo] are bit positions; lines under a group give offsets from that group; {n}, {i} and the like mark numbered series.

## FICR_NS — Factory Information Configuration Registers
Base 0x01FF0000
0x200 INFO group — Device info
  0x00 CONFIGID ro reset 0xFFFFFFFF — Configuration identifier
    [15:0] HWID — Identification number for the HW
  {0x4+4j} DEVICEID[{j}] (j=0..1) ro reset 0xFFFFFFFF — Description collection: Device identifier
    [31:0] DEVICEID — 64 bit unique device identifier
  0x0C PART ro reset 0x5340 — Part code
    [31:0] PART
      0x5340=N5340 (nRF5340); 0xFFFFFFFF=Unspecified
  0x10 VARIANT ro reset 0xFFFFFFFF — Part Variant, Hardware version and Production configuration
    [31:0] VARIANT — Part Variant, Hardware version and Production configuration, encoded as ASCII
      0x41414141=AAAA; 0xFFFFFFFF=Unspecified
  0x14 PACKAGE ro reset 0xFFFFFFFF — Package option
    [31:0] PACKAGE
      0x2000=QF (QFxx - 94 pin QFN); 0xFFFFFFFF=Unspecified
  0x18 RAM ro reset 0xFFFFFFFF — RAM variant
    [31:0] RAM
      16=K16 (16 kByte RAM); 32=K32 (32 kByte RAM); 64=K64 (64 kByte RAM); 128=K128 (128 kByte RAM); 0x100=K256 (256 kByte RAM); 0x200=K512 (512 kByte RAM); 0xFFFFFFFF=Unspecified
  0x1C FLASH ro reset 0xFFFFFFFF — Flash variant
    [31:0] FLASH
      128=K128 (128 kByte FLASH); 0x100=K256 (256 kByte FLASH); 0x200=K512 (512 kByte FLASH); 0x400=K1024 (1 MByte FLASH); 0x800=K2048 (2 MByte FLASH); 0xFFFFFFFF=Unspecified
  0x20 CODEPAGESIZE ro reset 0xFFFFFFFF — Code memory page size in bytes
    [31:0] CODEPAGESIZE
      0x800=K2048 (2 kByte)
  0x24 CODESIZE ro reset 0xFFFFFFFF — Code memory size
    [31:0] CODESIZE — Code memory size in number of pages
      128=P128 (128 pages)
  0x28 DEVICETYPE ro reset 0xFFFFFFFF
    [31:0] DEVICETYPE
      0=Die (Device is an physical DIE); 0xFFFFFFFF=FPGA (Device is an FPGA)
{0x280+4i} ER[{i}] (i=0..3) ro reset 0xFFFFFFFF — Description collection: Encryption Root, word n
  [31:0] ER — Encryption Root, word n
{0x290+4i} IR[{i}] (i=0..3) ro reset 0xFFFFFFFF — Description collection: Identity Root, word n
  [31:0] IR — Identity Root, word n
0x2A0 DEVICEADDRTYPE ro reset 0xFFFFFFFF — Device address type
  [0] DEVICEADDRTYPE
    0=Public address; 1=Random address
{0x2A4+4i} DEVICEADDR[{i}] (i=0..1) ro reset 0xFFFFFFFF — Description collection: Device address n
  [31:0] DEVICEADDR — 48 bit device address
{0x300+8i} TRIMCNF[{i}] (i=0..31) group — Unspecified
  0x00 ADDR reset 0xFFFFFFFF — Description cluster: Address
    [31:0] Address
  0x04 DATA ro reset 0xFFFFFFFF — Description cluster: Data

## UICR_NS — User Information Configuration Registers
Base 0x01FF8000
0x00 APPROTECT — Access port protection
  [31:0] PALL — Blocks debugger read/write access to all CPU registers and memory mapped addresses Any value except for the enumerations will yield unexpected results.
    0xFFFFFFFF=Unprotected; 0=Protected
0x04 ERASEPROTECT — Erase protection
  [31:0] PALL — Blocks NVMC ERASEALL and CTRLAP ERASEALL functionality. Any value except for the enumerations will yield unexpected results.
    0xFFFFFFFF=Unprotected; 0=Protected
{0x200+4i} NRFFW[{i}] (i=0..31) reset 0xFFFFFFFF — Description collection: Reserved for Nordic firmware design
  [31:0] NRFFW — Reserved for Nordic firmware design
{0x300+4i} CUSTOMER[{i}] (i=0..31) reset 0xFFFFFFFF — Description collection: Reserved for customer
  [31:0] CUSTOMER — Reserved for customer

## DCNF_NS — Domain configuration management
Base 0x41000000
0x420 CPUID ro reset 0x1 — CPU ID of this subsystem
  [7:0] CPUID

## VREQCTRL_NS — Voltage request control
Base 0x41004000
0x500 VREGRADIO group — Unspecified
  0x00 VREQH — Request high voltage on RADIO After requesting high voltage, the user must wait until VREQHREADY is set to Ready
    [0] VREQH — Request high voltage
      0=Disabled; 1=Enabled
  0x08 VREQHREADY ro — High voltage on RADIO is ready
    [0] READY — RADIO is ready to operate on high voltage
      0=NotReady; 1=Ready

## Notices in the file
Copyright (c) 2010 - 2018, Nordic Semiconductor ASA All rights reserved.
Redistribution and use in source and binary forms, with or without
modification, are permitted provided that the following conditions are met:
1. Redistributions of source code must retain the above copyright notice, this
list of conditions and the following disclaimer.
2. Redistributions in binary form must reproduce the above copyright
notice, this list of conditions and the following disclaimer in the
documentation and/or other materials provided with the distribution.
3. Neither the name of Nordic Semiconductor ASA nor the names of its
contributors may be used to endorse or promote products derived from this
software without specific prior written permission.
THIS SOFTWARE IS PROVIDED BY THE COPYRIGHT HOLDERS AND CONTRIBUTORS "AS IS"
AND ANY EXPRESS OR IMPLIED WARRANTIES, INCLUDING, BUT NOT LIMITED TO, THE
IMPLIED WARRANTIES OF MERCHANTABILITY, AND FITNESS FOR A PARTICULAR PURPOSE
ARE DISCLAIMED. IN NO EVENT SHALL NORDIC SEMICONDUCTOR ASA OR CONTRIBUTORS BE
LIABLE FOR ANY DIRECT, INDIRECT, INCIDENTAL, SPECIAL, EXEMPLARY, OR
CONSEQUENTIAL DAMAGES (INCLUDING, BUT NOT LIMITED TO, PROCUREMENT OF
SUBSTITUTE GOODS OR SERVICES; LOSS OF USE, DATA, OR PROFITS; OR BUSINESS
INTERRUPTION) HOWEVER CAUSED AND ON ANY THEORY OF LIABILITY, WHETHER IN
CONTRACT, STRICT LIABILITY, OR TORT (INCLUDING NEGLIGENCE OR OTHERWISE)
ARISING IN ANY WAY OUT OF THE USE OF THIS SOFTWARE, EVEN IF ADVISED OF THE
POSSIBILITY OF SUCH DAMAGE.
